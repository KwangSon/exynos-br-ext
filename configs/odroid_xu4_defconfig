## configs/odroid_xu4_defconfig
```kconfig
BR2_arm=y
BR2_cortex_a15_a7=y
BR2_KERNEL_HEADERS_6_4=y
BR2_PACKAGE_OVERRIDE_FILE="${BR2_EXTERNAL_ODXU4_PATH}/external.mk"
BR2_ROOTFS_POST_IMAGE_SCRIPT="support/scripts/genimage.sh"
BR2_ROOTFS_POST_SCRIPT_ARGS="-c ${BR2_EXTERNAL_ODXU4_PATH}/board/xu4/genimage-xu4.cfg"
BR2_LINUX_KERNEL=y
BR2_LINUX_KERNEL_DEFCONFIG="exynos"
BR2_LINUX_KERNEL_DTS_SUPPORT=y
BR2_LINUX_KERNEL_INTREE_DTS_NAME="samsung/exynos5422-odroidxu4"
BR2_PACKAGE_OPENSSH=y
BR2_TARGET_ROOTFS_EXT2=y
BR2_PACKAGE_HOST_GENIMAGE=y
```
